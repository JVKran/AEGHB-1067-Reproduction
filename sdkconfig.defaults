## sdkconfig.defaults
```kconfig
CONFIG_FREERTOS_ENABLE_BACKWARD_COMPATIBILITY=y
CONFIG_TINYUSB_CDC_ENABLED=y
CONFIG_TINYUSB_MSC_ENABLED=y

CONFIG_PARTITION_TABLE_CUSTOM=y
CONFIG_PARTITION_TABLE_CUSTOM_FILENAME="partitions.csv"
CONFIG_PARTITION_TABLE_FILENAME="partitions.csv"
CONFIG_ESPTOOLPY_FLASHSIZE_4MB=y
CONFIG_WL_SECTOR_SIZE_512=y
CONFIG_WL_SECTOR_MODE_PERF=y

CONFIG_FATFS_LFN_HEAP=y

CONFIG_USB_DEVICE_UAC_AS_PART=y
CONFIG_UAC_SPEAKER_CHANNEL_NUM=1
CONFIG_UAC_MIC_CHANNEL_NUM=0
```
